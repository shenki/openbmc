## meta-aspeed/conf/machine/include/ast2700.inc
```bitbake
SOC_FAMILY = "aspeed-g7"

include conf/machine/include/soc-family.inc
require conf/machine/include/aspeed.inc
include conf/machine/include/arm/arch-armv8a.inc
```

## meta-ingrasys/meta-zaius/conf/machine/zaius.conf
```bitbake
KMACHINE = "aspeed"
KERNEL_DEVICETREE = "${KMACHINE}-bmc-opp-${MACHINE}.dtb"

UBOOT_MACHINE = "evb-ast2500_defconfig"

FLASH_SIZE = "65536"

require conf/machine/include/ast2500.inc
require conf/machine/include/obmc-bsp-common.inc
require conf/machine/include/ingrasys.inc
require conf/machine/include/p9.inc
```

## meta-mellanox/meta-msn/conf/machine/msn.conf
```bitbake
KMACHINE = "aspeed"
KERNEL_DEVICETREE = "${KMACHINE}-bmc-mellanox-${MACHINE}.dtb"

UBOOT_MACHINE = "evb-ast2500_defconfig"

FLASH_SIZE = "32768"

require conf/machine/include/ast2500.inc
require conf/machine/include/obmc-bsp-common.inc
```

## meta-microwatt/conf/layer.conf
```bitbake
# We have a conf and classes directory, add to BBPATH
BBPATH .= ":${LAYERDIR}"

# We have recipes-* directories, add to BBFILES
BBFILES += "${LAYERDIR}/recipes-*/*/*.bb \
            ${LAYERDIR}/recipes-*/*/*.bbappend"

BBFILE_COLLECTIONS += "meta-microwatt"
BBFILE_PATTERN_meta-microwatt = "^${LAYERDIR}/"
BBFILE_PRIORITY_meta-microwatt = "6"

LAYERDEPENDS_meta-microwatt = "core"
LAYERSERIES_COMPAT_meta-microwatt = "gatesgarth"
```

## meta-microwatt/conf/machine/include/microwatt.inc
```bitbake
PREFERRED_PROVIDER_virtual/kernel ?= "linux-microwatt"

# Build a FIT image and stuff core-image-minimal in it by default.
KERNEL_IMAGETYPE ?= "dtbImage.microwatt"
INITRAMFS_IMAGE ?= "aspeed-image-initramfs"
INITRAMFS_FSTYPES ?= "cpio.xz"

WKS_FILE ?= "emmc-aspeed.wks.in"
WKS_FILE_DEPENDS ?= " \
    phosphor-hostfw-image \
    virtual/kernel \
"
WKS_HOSTFW_SIZE ?= "5G"
IMAGE_BOOT_FILES ?= "dtbImage.microwatt;kernel"

MACHINE_EXTRA_RRECOMMENDS += "udev-aspeed-vuart udev-aspeed-mtd-partitions"
MACHINE_FEATURES += "hw-rng"

SERIAL_CONSOLES ?= "115200;ttyS4"

DEFAULTTUNE_microwatt := "powerpc64le"

# Add general MACHINEOVERRIDE for meta-microwatt
MACHINEOVERRIDES =. "microwatt:"

include conf/machine/include/powerpc/arch-powerpc64.inc
```
